## firmware/esp32_robot_idf/main/Kconfig.projbuild
```kconfig
menu "Sprocket Robotics"

choice BR_BOARD
    prompt "Target board"
    default BR_BOARD_AITHINKER_CAM if IDF_TARGET_ESP32
    default BR_BOARD_S3_CAM        if IDF_TARGET_ESP32S3
    default BR_BOARD_C3_SUPERMINI  if IDF_TARGET_ESP32C3
    help
        Selects board-specific defaults: camera/PSRAM presence, pin map
        defaults, and the forbidden-pin set used by pin_config.c's
        validator. Choices are filtered to the active IDF target.

config BR_BOARD_AITHINKER_CAM
    bool "AI-Thinker ESP32-CAM (camera + PSRAM)"
    depends on IDF_TARGET_ESP32
    select BR_HAS_CAMERA
    select BR_HAS_PSRAM

config BR_BOARD_DEVKIT
    bool "ESP32 DevKitV1 / WROOM-32 (no camera, no PSRAM)"
    depends on IDF_TARGET_ESP32

config BR_BOARD_S3_CAM
    bool "Freenove ESP32-S3-WROOM CAM (camera + octal PSRAM + onboard WS2812)"
    depends on IDF_TARGET_ESP32S3
    select BR_HAS_CAMERA
    select BR_HAS_PSRAM
    select BR_HAS_WS2812
    select BR_HAS_PYVM

config BR_BOARD_C3_SUPERMINI
    bool "ESP32-C3 SuperMini (RISC-V, no camera, no PSRAM)"
    depends on IDF_TARGET_ESP32C3

endchoice

# Hidden caps — driven by the board choice. Source files and build deps
# gate on these, so the camera path can be dropped on no-camera boards
# without scattering CONFIG_BR_BOARD_* across every #ifdef.
config BR_HAS_CAMERA
    bool

config BR_HAS_PSRAM
    bool

# Embedded MicroPython VM (issue #47) — runs student Python scripts from the
# LittleFS drive. Needs PSRAM for the GC heap, so only PSRAM boards select it.
config BR_HAS_PYVM
    bool

# Onboard single-wire addressable RGB (WS2812/NeoPixel). Gates ws2812.c and
# the led_strip dependency; boards with a plain-GPIO LED don't select it.
config BR_HAS_WS2812
    bool

endmenu
```

## firmware/esp32_robot_idf/sdkconfig.defaults
```kconfig
# Defaults applied on first build (idf.py reconfigure regenerates sdkconfig
# from these). Per-target overrides go in sdkconfig.defaults.<target>.

# WebRTC needs network + SCTP-friendly LWIP buffer sizes. Camera + NimBLE
# both want PSRAM. PSRAM mode is set per-target since classic ESP32 uses
# external SPI PSRAM and S3 uses Octal PSRAM.

# Logging
CONFIG_LOG_DEFAULT_LEVEL_INFO=y

# Bluetooth (NimBLE — matches Arduino stack)
CONFIG_BT_ENABLED=y
CONFIG_BT_NIMBLE_ENABLED=y
CONFIG_BT_CONTROLLER_ONLY=n
CONFIG_BT_BLUEDROID_ENABLED=n
# Phase 2.F.2: phone-pair via BLE-relay needs both phone and desktop
# concurrently connected to the same robot. Default is 1; bump to 4
# to give headroom (operator's phone, desktop, and a couple of guest
# clients during demos).
CONFIG_BT_NIMBLE_MAX_CONNECTIONS=4
# CCCDs are per (conn × notify-char) subscription. With 4 conns and ~10
# notify-capable chars, the default 8 is far too low — ble_gatts_count_cfg
# returns EINVAL (rc=3) and the GATT table never registers, so the
# dashboard sees "No Services matching UUID … found in Device".
CONFIG_BT_NIMBLE_MAX_CCCDS=32

# Networking — bigger LWIP buffers help SCTP throughput on data channels.
CONFIG_LWIP_TCP_SND_BUF_DEFAULT=16384
CONFIG_LWIP_TCP_WND_DEFAULT=16384
# UDP send-side: libpeer's video-frame sends spammed "sendto: ENOMEM"
# on classic ESP32 with default WiFi TX buffers. Doubling the dynamic
# tx pool gives lwIP/WiFi room to drain JPEG bursts (each ~5-15 KB)
# without throwing pbuf-alloc failures. Static rx untouched (BLE coex
# already deals with it well).
CONFIG_ESP_WIFI_DYNAMIC_TX_BUFFER_NUM=64
CONFIG_LWIP_UDP_RECVMBOX_SIZE=16

# mbedTLS — libpeer needs DTLS; default subset usually works but be explicit
CONFIG_MBEDTLS_SSL_PROTO_DTLS=y
CONFIG_MBEDTLS_HARDWARE_AES=y
CONFIG_MBEDTLS_HARDWARE_SHA=y
# Mozilla root CA bundle — wss://signal.neevs.io needs server cert verification
# without us shipping a per-host PEM in flash.
CONFIG_MBEDTLS_CERTIFICATE_BUNDLE=y
CONFIG_MBEDTLS_CERTIFICATE_BUNDLE_DEFAULT_FULL=y
# mbedTLS allocations stay in internal DRAM. Was set to SPIRAM earlier
# because ssl_setup returned SSL_ALLOC_FAILED with a fragmented heap —
# but PSRAM is 4-8× slower than DRAM and most of the chip's perceived
# 30s ICE/WebRTC handshake time was crypto running over PSRAM. With
# pair-mailbox removed and turn_creds gone, internal DRAM has room for
# the ~8 KB handshake context. If SSL_ALLOC_FAILED returns, this flips
# back on; the speedup vs the OOM-risk is worth a try.
# CONFIG_MBEDTLS_EXTERNAL_MEM_ALLOC=y

# Camera framebuffer in PSRAM
CONFIG_CAMERA_TASK_STACK_SIZE=4096

# Partition table — OTA needs two app slots + factory.
CONFIG_PARTITION_TABLE_CUSTOM=y
CONFIG_PARTITION_TABLE_CUSTOM_FILENAME="partitions.csv"
```

## firmware/esp32_robot_idf/sdkconfig.defaults.esp32
```kconfig
# Classic ESP32 — AI-Thinker ESP32-CAM (the "MB" board the user has).
# 4 MB SPI PSRAM via the bundled chip; no hardware H.264 — camera path
# falls back to MJPEG-in-RTP for WebRTC video tracks.
CONFIG_ESPTOOLPY_FLASHSIZE_4MB=y
CONFIG_ESP32_SPIRAM_SUPPORT=y
CONFIG_SPIRAM_USE_MALLOC=y
CONFIG_SPIRAM_TRY_ALLOCATE_WIFI_LWIP=y
```

## firmware/esp32_robot_idf/sdkconfig.defaults.esp32s3
```kconfig
# ESP32-S3 (canonical target — Octal PSRAM + hardware H.264 encoder)
CONFIG_ESPTOOLPY_FLASHSIZE_4MB=y
CONFIG_ESP32S3_SPIRAM_SUPPORT=y
CONFIG_SPIRAM_MODE_OCT=y
CONFIG_SPIRAM_USE_MALLOC=y
# Reserve internal RAM for time-critical paths (NimBLE, camera DMA).
CONFIG_SPIRAM_TRY_ALLOCATE_WIFI_LWIP=y
```
